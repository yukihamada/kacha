## firmware/sdkconfig.defaults
```kconfig
# KAGI ESP-IDF SDK Config
CONFIG_IDF_TARGET="esp32s3"

# WiFi
CONFIG_ESP_WIFI_ENABLED=y

# BLE
CONFIG_BT_ENABLED=y
CONFIG_BT_BLE_ENABLED=y

# NVS (暗号化は量産時にeFuse設定後に有効化)
# CONFIG_NVS_ENCRYPTION is not set

# Watchdog (最大60秒)
CONFIG_ESP_TASK_WDT=y
CONFIG_ESP_TASK_WDT_TIMEOUT_S=60

# Heap
CONFIG_ESP_SYSTEM_EVENT_TASK_STACK_SIZE=4096

# UART (LD2410B)
CONFIG_UART_ISR_IN_IRAM=y

# 省電力
CONFIG_PM_ENABLE=y
CONFIG_ESP_WIFI_STA_DISCONNECTED_PM_ENABLE=y

# OTA
CONFIG_BOOTLOADER_APP_ROLLBACK_ENABLE=y
CONFIG_APP_ROLLBACK_ENABLE=y
```
